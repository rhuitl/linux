## arch/arm/mach-nuc700/Kconfig
```kconfig
if ARCH_NUC700

config CPU_NUC710
	bool
	help
	  Support for NUC710 of Nuvoton NUC700 CPUs.

config CPU_NUC740
	bool
	help
	  Support for NUC740 of Nuvoton NUC700 CPUs.

config CPU_NUC745
	bool
	help
	  Support for NUC745 of Nuvoton NUC700 CPUs.

config ZSWAN_DEBUG_UART
	bool "For zswan porting kernel use debug uart0!"
	help
	  If you doubt serial driver is not ok for debug other driver,
	  you can use this option to debug.

config CACHE_NUC700
	bool "NUC700 has a private cache management controller!"
	help
	  NUC700 has a private cache management controller, if you have
	  some srange codes bugs, you can disable this to debug.

menu "NUC710 Machines"

config MACH_NUC710EVB
	bool "Nuvoton NUC710 Evaluation Board"
	default y
	select CPU_NUC710
	help
	   Say Y here if you are using the Nuvoton NUC710EVB
endmenu

menu "NUC745 Machines"

config MACH_NUC745EVB
	bool "Nuvoton NUC745 Evaluation Board"
	select CPU_NUC745
	help
	   Say Y here if you are using the Nuvoton NUC745EVB

endmenu

menu "NUC740 Machines"

config MACH_NUC740EVB
	bool "Nuvoton NUC740 Evaluation Board"
	select CPU_NUC740
	help
	   Say Y here if you are using the Nuvoton NUC740EVB

endmenu

menu "NUC700 UART Using"
config NUC700_UART1
	bool "Uart1 support"
	default n
	depends on MACH_NUC710EVB || MACH_NUC740EVB || MACH_NUC745EVB
	help
	   Say Y here if you are using the Nuvoton NUC700EVB

config NUC700_UART1_CTSRTS
	bool "Uart1 support CTS/RTS functions?"
	default n
	depends on NUC700_UART1
	help
	   Say Y here if you are not using the uart2, which is conflict to uart1
	   cts/rts function.

config NUC700_UART2
	bool "Uart2 support"
	default n
	depends on (MACH_NUC710EVB || MACH_NUC740EVB || MACH_NUC745EVB) && (!NUC700_UART1_CTSRTS)
	help
	   Say Y here if you are using the Nuvoton NUC700EVB
config NUC700_UART3
	bool "Uart3 support"
	default n
	depends on MACH_NUC710EVB || MACH_NUC740EVB || MACH_NUC745EVB
	help
	   Say Y here if you are using the Nuvoton NUC700EVB
endmenu
endif
```

## sound/soc/nuc700/Kconfig
```kconfig
##
## NUC700 series AC97 API
##
config SND_SOC_NUC700
	tristate "SoC Audio for NUC700 series"
	depends on ARCH_NUC700
	help
	  This option enables support for AC97 mode on the NUC700 SoC.

config SND_SOC_NUC700_AC97
	tristate
	select AC97_BUS
	select SND_AC97_CODEC
	select SND_SOC_AC97_BUS


##
## Boards
##
config SND_SOC_NUC700EVB
	tristate "NUC700 AC97 support for demo board"
	depends on SND_SOC_NUC700
	select SND_SOC_NUC700_AC97
	select SND_SOC_AC97_CODEC
	help
	  Select this option to enable audio (AC97) on the
	  NUC700 demoboard.
```
